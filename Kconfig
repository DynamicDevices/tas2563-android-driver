## Kconfig
```kconfig
menuconfig SND_SOC_TAS2563
	tristate "Texas Instruments TAS2563 SmartAmp(R)"

if SND_SOC_TAS2563
config TAS2563_REGMAP
    bool "Use of RegMap API"

config TAS2563_CODEC
    bool "Codec Driver support"

config TAS2563_MISC
    bool "Misc Driver support"
	
endif # SND_SOC_TAS2563
```
